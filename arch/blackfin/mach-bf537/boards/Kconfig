## arch/blackfin/mach-bf537/boards/Kconfig
```kconfig
choice
	prompt "System type"
	default BFIN537_STAMP
	help
	  Select your board!

config BFIN537_STAMP
	bool "BF537-STAMP"
	help
	  BF537-STAMP board support.
	  
config BFIN537_INDXCAM
	bool "BF537-INDXCAM"
	depends on (BF537)
	help
	  Support for indXcam intelligent camera.

config BFIN537_LEANXCAM
	bool "BF537-LEANXCAM"
	depends on (BF537)
	help
	  Support for leanXcam intelligent camera.

config BFIN537_BLUETECHNIX_CM_E
	bool "Bluetechnix CM-BF537E"
	depends on (BF537)
	help
	  CM-BF537E support for EVAL- and DEV-Board.

config BFIN537_BLUETECHNIX_CM_U
	bool "Bluetechnix CM-BF537U"
	depends on (BF537)
	help
	  CM-BF537U support for EVAL- and DEV-Board.

config BFIN537_BLUETECHNIX_TCM
	bool "Bluetechnix TCM-BF537"
	depends on (BF537)
	help
	  TCM-BF537 support for EVAL- and DEV-Board.

config PNAV10
	bool "PNAV board"
	depends on (BF537)
	help
	  PNAV board support.

config CAMSIG_MINOTAUR
	bool "Cambridge Signal Processing LTD Minotaur"
	depends on (BF537)
	help
	  Board supply package for CSP Minotaur

endchoice
```

## drivers/media/video/blackfin/Kconfig
```kconfig
config VIDEO_BLACKFIN_CAM
	tristate "Blackfin Camera driver"
	depends on BLACKFIN && VIDEO_DEV && I2C
	select VIDEO_V4L1_COMPAT
	default n
	help
	  V4L Support for CMOS camera sensor attached to the Blackfin PPI.

	  To compile this driver as a module, choose M here: the
	  module will be called blackfin_cam.

config VIDEO_BLACKFIN_CAM_PPI1
	bool "Camera attached to PPI1 instead of PPI0"
	depends on BF561 && VIDEO_BLACKFIN_CAM
	default n
	help
	  The BF561 processor has two PPI interfaces, PPI0 and PPI1, instead of
	  the single PPI on other Blackfin processors.  By default, PP0 is used.
	  Select this option if you wish to use PPI1 instead.

config VIDEO_MT9V032_OSCAR
	tristate "Micron MT9V032 Camera driver used by OSCAR framework"
	depends on BLACKFIN && I2C
	default n
	help
	  Support for the Micron MT9V032 camera attached to
	  the Blackfin PPI. Although the API is very similar,
	  this driver is not compatible to video4linux but instead
	  implements functionality not provided by video4linux.

	  The SCS Open-Source Camera (OSCAR) framework for leanXcam
	  and derived products depend on this driver.

	  To compile this driver as a module, choose M here: the
	  module will be called mt9v032.

comment "CMOS Camera Sensor Selection"

choice
	prompt "Target Sensor"
	depends on VIDEO_BLACKFIN_MT9M001 || VIDEO_BLACKFIN_CAM	
	default MT9V022

config MT9V022
	bool "MT9V022"
	help
	  Micron MT9V022 Sensor Support

config MT9M001
	bool "MT9M001"
	depends on VIDEO_BLACKFIN_MT9M001
	help
	  Micron MT9M001 Sensor Support

config VS6524
	bool "VS6524"
	depends on VIDEO_BLACKFIN_CAM
	help
	  ST VS6524 Sensor Support

config VS6624
	bool "VS6624"
	depends on VIDEO_BLACKFIN_CAM
	help
	  ST VS6624 Sensor Support

config OV9655
	bool "OV9655"
	depends on VIDEO_BLACKFIN_CAM && EXPERIMENTAL
	help
	  Omnivision OV9655 Sensor Support
	  This is work in progress. NOT YET COMPLETE.

config ADV7183B
       bool "ADV7183B"
       depends on VIDEO_BLACKFIN_CAM
       help
         ADV7183B Sensor Support


endchoice
```
